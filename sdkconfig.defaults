## sdkconfig.defaults
```kconfig
# Arduino配置
CONFIG_FREERTOS_HZ=1000
CONFIG_ARDUHAL_LOG_DEFAULT_LEVEL=1
CONFIG_ARDUINO_SELECTIVE_COMPILATION=n
CONFIG_ENABLE_ARDUINO_DEPENDS=y

# ESP32摄像头相关配置
CONFIG_SPIRAM=y
CONFIG_SPIRAM_BOOT_INIT=y
CONFIG_SPIRAM_USE_MALLOC=y
CONFIG_SPIRAM_TYPE_AUTO=y
CONFIG_SPIRAM_SIZE=-1
CONFIG_SPIRAM_SPEED_80M=y
CONFIG_SPIRAM_CACHE_WORKAROUND=y

# 启用组件
CONFIG_TEMP_SENSOR=y
CONFIG_ESP_HTTPS_SERVER_ENABLE=n

# 使用app_main方式运行Arduino，而不是自动启动setup/loop
CONFIG_AUTOSTART_ARDUINO=n

# 网络相关配置
CONFIG_LWIP_SO_RCVBUF=y
CONFIG_LWIP_MAX_SOCKETS=16
CONFIG_ESP_WIFI_STATIC_RX_BUFFER_NUM=16

# ESP32特定配置
CONFIG_ESP_MAIN_TASK_STACK_SIZE=4096
CONFIG_ESP_SYSTEM_EVENT_TASK_STACK_SIZE=4096

# 硬件配置
CONFIG_ESP32S3_SPIRAM_SUPPORT=y
CONFIG_FREERTOS_UNICORE=n
CONFIG_FREERTOS_ENABLE_STATIC_TASK_CLEAN_UP=n

# PSRAM配置
CONFIG_SPIRAM_MODE_OCT=y
CONFIG_SPIRAM_CLK_IO=30
CONFIG_SPIRAM_CS_IO=26
CONFIG_SPIRAM_MEMTEST=y
CONFIG_SPIRAM_MALLOC_ALWAYSINTERNAL=16384
CONFIG_SPIRAM_MALLOC_RESERVE_INTERNAL=32768
CONFIG_SPIRAM_ALLOW_STACK_EXTERNAL_MEMORY=y

# 摄像头配置
CONFIG_ESP32_CAMERA_PSRAM=y
CONFIG_CAMERA_TASK_STACK_SIZE=8192

# 其他配置
CONFIG_ESP_SYSTEM_MEMPROT_FEATURE=n 
```
